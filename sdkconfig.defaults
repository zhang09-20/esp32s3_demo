## sdkconfig.defaults
```kconfig
# Set target chip to ESP32-S3
CONFIG_IDF_TARGET="esp32s3"

# SPI DMA configuration
CONFIG_SPI_MASTER_IN_IRAM=y
CONFIG_SPI_MASTER_ISR_IN_IRAM=y

# Optimization settings
CONFIG_COMPILER_OPTIMIZATION_PERF=y
CONFIG_COMPILER_OPTIMIZATION_ASSERTIONS_ENABLE=y

# FreeRTOS configuration
CONFIG_FREERTOS_HZ=1000 
```
